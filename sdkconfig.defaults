## src/Kconfig.projbuild
```kconfig
menu "Fussball diagnostics"

    config FUSSBALL_BUDGET_PROBE
        bool "Build the P1.8 integration budget probe"
        default n
        help
            Adds WiFi, SNTP, HTTPS and filtered JSON parsing (ArduinoJson) as a
            diagnostic task that measures the C6 memory budget. Only the
            environment xiao_esp32c6_gc9a01_budget enables it
            (sdkconfig.defaults.budget); the probe is removed after the
            measurements (P1.8).

endmenu
```
